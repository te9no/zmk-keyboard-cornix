## Kconfig
```kconfig
config ZMK_CDC_ACM_BOOTLOADER_TRIGGER
    bool "Enter the UF2 bootloader after a 1200-baud CDC touch"
    select USB_CDC_ACM

if ZMK_CDC_ACM_BOOTLOADER_TRIGGER

config ZMK_CDC_ACM_BOOTLOADER_TRIGGER_DELAY_MS
    int "Delay before entering the bootloader"
    default 100

endif

config CORNIX_BLE_LINK_MONITOR
    bool "Log only BLE link state transitions"
    depends on BT

config CORNIX_PMW3610_DIAGNOSTICS
    bool "Periodically log PMW3610 startup and bus diagnostics"
    depends on PMW3610
    depends on GPIO

config CORNIX_HOST_BOND_RESET
    bool "Clear Central host profiles while preserving split peripheral bonds"
    depends on ZMK_BLE
    depends on ZMK_SPLIT_ROLE_CENTRAL

config CORNIX_SPLIT_BOND_RESET
    bool "Clear all split peripheral bonds while preserving host profiles"
    depends on ZMK_BLE
    depends on ZMK_SPLIT_ROLE_CENTRAL
    depends on SETTINGS

if CORNIX_SPLIT_BOND_RESET

config CORNIX_SPLIT_BOND_RESET_DELAY_MS
    int "Delay before clearing split peripheral bonds"
    range 1000 30000
    default 5000

endif

config MADULA_WS2812_LAYER_NUMBER
    bool "Blink the highest active layer number on Madula's shared SPI LED"
    depends on SHIELD_MADULA_CENTRAL
    depends on RGBLED_WIDGET && RGBLED_WIDGET_WS2812
    depends on ZMK_SPLIT_ROLE_CENTRAL
    help
      Use the widget's priority/sharing API; never override a higher-priority
      battery or connectivity indication. Layer 0 has no pulse. Other layers
      blink their numeric index, then return the LED to its previous state.

config CORNIX_CENTRAL_RGB_LED
    bool "Blink the active layer on the Central XIAO RGB LED"
    depends on GPIO
    depends on ZMK_SPLIT_ROLE_CENTRAL

if CORNIX_CENTRAL_RGB_LED

config CORNIX_CENTRAL_RGB_LED_DURATION_MS
    int "Layer indication duration in milliseconds"
    range 20 2000
    default 120

config CORNIX_CENTRAL_RGB_LED_BOOT_STATUS
    bool "Show battery and connection status at boot"
    default y

if CORNIX_CENTRAL_RGB_LED_BOOT_STATUS

config CORNIX_CENTRAL_RGB_LED_BOOT_DELAY_MS
    int "Delay before the boot status sequence"
    range 0 5000
    default 200

config CORNIX_CENTRAL_RGB_LED_STATUS_DURATION_MS
    int "Duration of each boot status indication"
    range 100 5000
    default 500

config CORNIX_CENTRAL_RGB_LED_STATUS_INTERVAL_MS
    int "Dark interval between boot status indications"
    range 20 2000
    default 150

config CORNIX_CENTRAL_RGB_LED_BATTERY_LEVEL_HIGH
    int "High battery threshold"
    range 1 100
    default 80

config CORNIX_CENTRAL_RGB_LED_BATTERY_LEVEL_LOW
    int "Low battery threshold"
    range 0 99
    default 20

endif

endif
```

## boards/shields/cornix_madula_central/Kconfig.defconfig
```kconfig
# Copyright (c) 2026
# SPDX-License-Identifier: MIT

if SHIELD_CORNIX_MADULA_CENTRAL

config ZMK_KEYBOARD_NAME
    default "Cornix Madula"

config ZMK_SPLIT
    default y

config ZMK_SPLIT_ROLE_CENTRAL
    default y

config ZMK_SPLIT_BLE_ROLE_CENTRAL
    default y

config ZMK_SPLIT_BLE_CENTRAL_PERIPHERALS
    default 2

config ZMK_SPLIT_BLE_CENTRAL_BATTERY_LEVEL_FETCHING
    default y

if ZMK_SPLIT_BLE_CENTRAL_BATTERY_LEVEL_FETCHING

config ZMK_SPLIT_BLE_CENTRAL_BATTERY_LEVEL_PROXY
    default y

endif

config ZMK_BLE
    default y

config ZMK_USB
    default y

config INPUT
    default y

config ZMK_POINTING
    default y

config ADC
    default y

config ADC_NRFX_SAADC
    default y

config GPIO
    default y

endif # SHIELD_CORNIX_MADULA_CENTRAL
```

## boards/shields/cornix_madula_central/Kconfig.shield
```kconfig
# Copyright (c) 2026
# SPDX-License-Identifier: MIT

config SHIELD_CORNIX_MADULA_CENTRAL
    def_bool $(shields_list_contains,cornix_madula_central)
```

## boards/shields/cornix_madulo_central/Kconfig.shield
```kconfig
# Copyright (c) 2026
# SPDX-License-Identifier: MIT

config SHIELD_CORNIX_MADULO_CENTRAL
    def_bool $(shields_list_contains,cornix_madulo_central)
```

## boards/shields/madula_central/Kconfig.shield
```kconfig
# Copyright (c) 2026
# SPDX-License-Identifier: MIT

config SHIELD_MADULA_CENTRAL
    def_bool $(shields_list_contains,madula_central)
```

## config/west.yml
```yaml
manifest:
  remotes:
    - name: zmkfirmware
      url-base: https://github.com/zmkfirmware
    - name: hitsmaxft
      url-base: https://github.com/hitsmaxft
    - name: englmaxi
      url-base: https://github.com/englmaxi
    - name: urob
      url-base: https://github.com/urob
    - name: janpfischer
      url-base: https://github.com/janpfischer
    - name: AYM1607
      url-base: https://github.com/AYM1607
    - name: badjeff
      url-base: https://github.com/badjeff
    - name: te9no
      url-base: https://github.com/te9no
    - name: cormoran
      url-base: https://github.com/cormoran
  projects:
    - name: zmk
      remote: te9no
      revision: afe241df80b05c3f4e0cc95ada7584d24422a893
      import:
        file: app/west.yml
    - name: zmk-helpers
      remote: urob
      revision: 95edb8f15ef1d1bd8332810555f8cf5837fbdd27
      clone-depth: 1
    - name: zmk-layout-shift
      revision: 0f2fad97b32332e1832377aa8afd1ec213829190
      url: https://github.com/kot149/zmk-layout-shift
      path: modules/zmk-layout-shift
    - name: zmk-rgbled-widget
      remote: hitsmaxft
      revision: 6ac6efe7e0902ccef4ef3893ab0054535e727566
    - name: zmk-driver-azoteq-iqs5xx
      remote: AYM1607
      revision: 27321f0232b50f0af31eb27ff97d539933467ea4
      clone-depth: 1

    # Pointing-device drivers used by the interchangeable MeKaBu modules on
    # the Madula central.
    - name: ads1220-zephyr-module
      remote: te9no
      revision: 68071687cc7ea41e3eacc60521cb26b4311206e2

    # IQS9151 trackpad driver used by the MeKaBu IQS module on Madula.
    # Keep this revision aligned with the proven GeaconPolaris configuration.
    - name: zmk-driver-iqs9151-upstream
      url: https://github.com/ShiniNet/zmk-driver-iqs9151
      revision: 08a6fd19c5aa5ae7f11daf371b5a391cd8596783
      path: modules/zmk-driver-iqs9151-upstream

    # DYA Studio V2 runtime configuration and diagnostics.
    - name: zmk-module-runtime-input-processor
      revision: 72387b5212264d26d704dbc43c765f6485470a77
      url: https://github.com/te9no/zmk-module-runtime-input-processor
      path: modules/zmk-module-runtime-input-processor
    - name: zmk-behavior-runtime-sensor-rotate
      revision: 8b1125ed676c1f5e14145d217984f33d0ebdcef4
      url: https://github.com/cormoran/zmk-behavior-runtime-sensor-rotate
      path: modules/zmk-behavior-runtime-sensor-rotate
    - name: zmk-module-ble-management
      remote: cormoran
      revision: 57738cc4fc6ba80e82a7ac57741a0339cb186cd4
      path: modules/zmk-module-ble-management
    - name: zmk-module-settings-rpc
      revision: 083a299dd8d31c275809c5a249b12486be24a7d2
      url: https://github.com/te9no/zmk-module-settings-rpc
      path: modules/zmk-module-settings-rpc
    - name: zmk-feature-runtime-combo
      remote: cormoran
      revision: d9490e7b5d41c516221d131241009e81740efcee
      path: modules/zmk-feature-runtime-combo
      import:
        name-blocklist:
          - zmk-feature-custom-settings
    - name: zmk-feature-runtime-macro
      remote: cormoran
      revision: 38530962eb7061b60efcb98e84585cfb1f0cb6de
      path: modules/zmk-feature-runtime-macro
      import:
        name-blocklist:
          - zmk-feature-custom-settings
    - name: zmk-feature-custom-settings
      remote: cormoran
      revision: c6a7fef3a3be3d3ace5de9a4b0628c6418cd1f3f
      path: zmk-feature-custom-settings
    - name: zmk-feature-device-info
      remote: cormoran
      revision: 8cedd2dd9f04e19ea5a17b94914dd47a09d8db11
      path: modules/zmk-feature-device-info
    - name: zmk-feature-watchdog
      remote: cormoran
      revision: 84ad14c6c3645dc40b23f45d08ab45418655f912
      path: modules/zmk-feature-watchdog
    - name: zmk-feature-kscan-diagnostics
      remote: cormoran
      revision: 1432f7fe0cfe903cd7d3c9931ae6bd6f2e1f328e
      path: modules/zmk-feature-kscan-diagnostics
    - name: zmk-module-devtool
      remote: cormoran
      revision: 9938a2c73c06d6e65ba2c0b68c9aa044a467eafc
      path: modules/zmk-module-devtool
  self:
    path: config
```

## dts/bindings/zmk,cdc-acm-bootloader-trigger.yaml
```yaml
description: CDC ACM 1200-baud UF2 bootloader trigger

compatible: "zmk,cdc-acm-bootloader-trigger"

properties:
  cdc-port:
    type: phandle
    required: true
    description: CDC ACM UART monitored for the 1200-baud open/close sequence.
```
