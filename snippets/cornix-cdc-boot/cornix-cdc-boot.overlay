#include <common/nordic/nrf52840_uf2_boot_mode.dtsi>

/ {
    cornix_bootloader_trigger: cornix_bootloader_trigger {
        compatible = "zmk,cdc-acm-bootloader-trigger";
        cdc-port = <&snippet_zmk_usb_logging_uart>;
    };
};

/*
 * Keep the dedicated USB logging/CDC boot and Studio RPC CDC instances.
 * A third, unused board CDC function exhausts the nRF52840 USB endpoint
 * budget and can leave Studio enumerable but unable to receive RPC data.
 */
&board_cdc_acm_uart {
    status = "disabled";
};
