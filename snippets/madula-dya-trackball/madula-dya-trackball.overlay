#include <dt-bindings/zmk/input_transform.h>
#include <input/processors.dtsi>
#include <input/processors/runtime-input-processor.dtsi>

/* Keep the Madula mounting transform before optional Studio cursor tuning. */
&madula_trackball_listener {
    input-processors =
        <&zip_xy_transform
            (INPUT_TRANSFORM_XY_SWAP | INPUT_TRANSFORM_X_INVERT | INPUT_TRANSFORM_Y_INVERT)>,
        <&mouse_runtime_input_processor>;
};
