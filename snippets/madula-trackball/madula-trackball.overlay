/* MeKaBu PMW3610 input organ for Madula. */
#include <dt-bindings/gpio/gpio.h>
#include <dt-bindings/zmk/input_transform.h>
#include <zephyr/dt-bindings/input/input-event-codes.h>
#include <input/processors.dtsi>

/ {
    madula_tb_spi: spi-three-wire {
        compatible = "te9no,spi-three-wire-gpio";
        status = "okay";
        #address-cells = <1>;
        #size-cells = <0>;

        sck-gpios = <&gpio1 13 GPIO_ACTIVE_HIGH>;
        sdio-gpios = <&gpio1 15 GPIO_ACTIVE_HIGH>;
        cs-gpios = <&gpio1 12 GPIO_ACTIVE_LOW>;

        turnaround-delay-us = <4>;
        select-delay-us = <1>;
        deselect-delay-us = <4>;
        recovery-delay-us = <30>;

        madula_trackball: trackball@0 {
            status = "okay";
            compatible = "cormoran,pmw3610";
            reg = <0>;
            spi-max-frequency = <1500000>;
            irq-gpios = <&gpio1 14 (GPIO_ACTIVE_LOW | GPIO_PULL_UP)>;
            cpi = <800>;
            evt-type = <INPUT_EV_REL>;
            x-input-code = <INPUT_REL_X>;
            y-input-code = <INPUT_REL_Y>;
            force-awake;
            disable-burst-read;
            settings-id = "cornix-madula-tb";
        };
    };

    madula_trackball_listener: madula_trackball_listener {
        compatible = "zmk,input-listener";
        device = <&madula_trackball>;
        /* Madula mounting: up -> up, right -> right (swap, then invert both). */
        input-processors = <&zip_xy_transform
            (INPUT_TRANSFORM_XY_SWAP | INPUT_TRANSFORM_X_INVERT | INPUT_TRANSFORM_Y_INVERT)>;
    };
};
